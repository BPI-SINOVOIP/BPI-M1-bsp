## linux-sunxi/drivers/input/touchscreen/gt9xx/Kconfig
```kconfig
#
# SW Touchscreen driver configuration
#
config  TOUCHSCREEN_GT9XX
       tristate  "gt9xx touchscreen driver"      
       depends on I2C
       help
         gt9xx touchscreen driver    
```

## linux-sunxi/drivers/net/wireless/ap6211/Kconfig
```kconfig
config AP6211
	tristate "AMPAK AP6211 wireless/bluetooth module support"
	depends on MMC
	default n
	---help---
	  This module adds support for the wireless and bluetooth
	  module of the CubieTruck.

config AP6211_FW_PATH
	depends on AP6211
	string "Firmware path"
	default "/system/vendor/modules/fw_bcmxxxx.bin"
	---help---
	  Path to the firmware file.

config AP6211_NVRAM_PATH
	depends on AP6211
	string "NVRAM path"
	default "/system/vendor/modules/nvram_apxxxx.txt"
	---help---
	  Path to the calibration file.

config AP6211_WEXT
	bool "Enable WEXT support"
	depends on AP6211 && CFG80211 = n
	select WIRELESS_EXT
	select WEXT_PRIV
	help
	  Enables WEXT support

choice
    depends on AP6211
    prompt "Interrupt type"
config AP6211_OOB
	depends on AP6211
	bool "Out-of-Band Interrupt"
	---help---
		Interrupt through WL_HOST_WAKE.
config AP6211_SDIO_IRQ
	depends on  AP6211
	bool "In-Band Interrupt"
	default y
	---help---
		Interrupt through SDIO DAT[1]
endchoice
```

## linux-sunxi/drivers/net/wireless/rtl8192cu/Kconfig
```kconfig
config RTL8192CU_SW
	tristate "Realtek 8192C USB WiFi for SW"
	depends on USB
	---help---
	  Help message of RTL8192CU_SW
```

## linux-sunxi/sound/soc/sunxi/i2s/Kconfig
```kconfig
config SND_SUNXI_SOC_I2S_INTERFACE
	tristate "SoC i2s interface for the AllWinner sun4i, sun5i and sun7i chips"
	default m
	help
	  Say Y or M if you want to add support for codecs attached to
	  the SUNXI AC97, I2S or PCM interface. You will also need
	  to select the audio interfaces to support below.
```
